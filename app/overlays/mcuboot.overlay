/* Disable most of the peripherals
    and drivers as mcuboot 
    does not require them.
*/
&i2c1 {
    status = "disabled";    
};

&i2c2 {
    status = "disabled";
};

&spi0{
    status = "enabled";
};

$spi1{
    status = "enabled";
};